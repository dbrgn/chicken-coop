## rpi-image/configs/chickendoor_defconfig
```kconfig
# Enable experimental per-package directories to allow top-level parallel build
BR2_PER_PACKAGE_DIRECTORIES=y

# Use CCache
BR2_CCACHE=y
BR2_CCACHE_USE_BASEDIR=y

# Custom patches
BR2_GLOBAL_PATCH_DIR="$(BR2_EXTERNAL_CHICKENDOOR_PATH)/patches/"

# RPI
BR2_PACKAGE_RPI_FIRMWARE_CONFIG_FILE="$(BR2_EXTERNAL_CHICKENDOOR_PATH)/board/config.txt"
BR2_arm=y
BR2_cortex_a72=y
BR2_ARM_FPU_NEON_VFPV4=y
BR2_PACKAGE_RPI_FIRMWARE=y
BR2_PACKAGE_RPI_FIRMWARE_VARIANT_PI4_X=y
BR2_PACKAGE_RPI_USERLAND=y

# Kernel
BR2_PACKAGE_HOST_LINUX_HEADERS_CUSTOM_5_10=y
BR2_LINUX_KERNEL=y
BR2_LINUX_KERNEL_CUSTOM_TARBALL=y
BR2_LINUX_KERNEL_CUSTOM_TARBALL_LOCATION="$(call github,raspberrypi,linux,581049d718caf95f5feb00607ac748d5841cf27c)/linux-581049d718caf95f5feb00607ac748d5841cf27c.tar.gz"
BR2_LINUX_KERNEL_DEFCONFIG="bcm2711"
BR2_LINUX_KERNEL_DTS_SUPPORT=y
BR2_LINUX_KERNEL_INTREE_DTS_NAME="bcm2711-rpi-4-b"
BR2_LINUX_KERNEL_NEEDS_HOST_OPENSSL=y

# Toolchain (glibc with SSP is required for systemd)
BR2_TOOLCHAIN_BUILDROOT_GLIBC=y
BR2_TOOLCHAIN_BUILDROOT_CXX=y

# Rootfs
BR2_TARGET_ROOTFS_EXT2=y
BR2_TARGET_ROOTFS_EXT2_4=y
BR2_TARGET_ROOTFS_EXT2_SIZE="200M"
BR2_TARGET_ROOTFS_EXT2_LABEL="rootfs"
# BR2_TARGET_ROOTFS_TAR is not set
BR2_PACKAGE_HOST_DOSFSTOOLS=y
BR2_PACKAGE_HOST_GENIMAGE=y
BR2_PACKAGE_HOST_MTOOLS=y

# Rootfs overlay
BR2_ROOTFS_OVERLAY="$(BR2_EXTERNAL_CHICKENDOOR_PATH)/board/overlay/"

# Post build
BR2_ROOTFS_POST_BUILD_SCRIPT="board/raspberrypi4/post-build.sh"
BR2_ROOTFS_POST_IMAGE_SCRIPT="$(BR2_EXTERNAL_CHICKENDOOR_PATH)/board/post-image.sh"

# Init system
BR2_INIT_SYSTEMD=y
BR2_TARGET_GENERIC_GETTY_PORT="tty1"
BR2_TARGET_GENERIC_ISSUE="Welcome to Chicken Door!"

# Hostname and root password
BR2_TARGET_GENERIC_HOSTNAME="chickendoor"
BR2_TARGET_GENERIC_ROOT_PASSWD="tikkamasala"

# Locale and timezone
BR2_ENABLE_LOCALE=y
BR2_GENERATE_LOCALE="en_US.UTF-8"
BR2_TARGET_TZ_INFO=y
BR2_TARGET_TZ_ZONELIST="default"
BR2_TARGET_LOCALTIME="Europe/Zurich"

# Shell
BR2_PACKAGE_BASH=y
BR2_PACKAGE_READLINE=y
BR2_SYSTEM_BIN_SH_BASH=y
BR2_SYSTEM_BIN_SH="bash"

# Network
BR2_SYSTEM_DHCP="eth0"

# System utilities
BR2_PACKAGE_KBD=y
BR2_PACKAGE_TMUX=y
BR2_PACKAGE_HTOP=y
BR2_PACKAGE_I2C_TOOLS=y
BR2_PACKAGE_VIM=y
BR2_PACKAGE_VIM_RUNTIME=y

# SSH
BR2_PACKAGE_DROPBEAR=y
BR2_PACKAGE_DROPBEAR_CLIENT=n
BR2_PACKAGE_DROPBEAR_LEGACY_CRYPTO=n

# Webcam handling: libv4l
BR2_PACKAGE_LIBV4L=y
BR2_PACKAGE_LIBV4L_UTILS=y

# Video encoding: libx264
BR2_PACKAGE_X264=y

# Video acceleration: libva
BR2_PACKAGE_LIBVA=y

# Audio: ALSA
BR2_PACKAGE_ALSA_LIB=y
BR2_PACKAGE_ALSA_LIB_DEVDIR="/dev/snd"
BR2_PACKAGE_ALSA_LIB_PCM_PLUGINS="all"
BR2_PACKAGE_ALSA_LIB_CTL_PLUGINS="all"
BR2_PACKAGE_ALSA_LIB_ALOAD=y
BR2_PACKAGE_ALSA_LIB_MIXER=y
BR2_PACKAGE_ALSA_LIB_PCM=y
BR2_PACKAGE_ALSA_LIB_RAWMIDI=y
BR2_PACKAGE_ALSA_LIB_HWDEP=y
BR2_PACKAGE_ALSA_LIB_SEQ=y
BR2_PACKAGE_ALSA_LIB_UCM=y
BR2_PACKAGE_ALSA_LIB_ALISP=y
BR2_PACKAGE_ALSA_LIB_OLD_SYMBOLS=y
BR2_PACKAGE_ALSA_UTILS=y
BR2_PACKAGE_ALSA_UTILS_ALSACTL=y
BR2_PACKAGE_ALSA_UTILS_ALSAMIXER=y
BR2_PACKAGE_ALSA_UTILS_APLAY=y

# Opus
BR2_PACKAGE_OPUS=y
BR2_PACKAGE_LIBOPUSENC=y

# ffmpeg
BR2_PACKAGE_FFMPEG=y
BR2_PACKAGE_FFMPEG_GPL=y
BR2_PACKAGE_FFMPEG_FFPROBE=y
BR2_PACKAGE_FFMPEG_SWSCALE=y
BR2_PACKAGE_FFMPEG_ENCODERS="h264_omx h264_v4l2m2m libx264 libopus"
BR2_PACKAGE_FFMPEG_DECODERS="rawvideo mjpeg h264_mmal h264_v4l2m2m pcm_s16le"
BR2_PACKAGE_FFMPEG_MUXERS="rtp opus"
BR2_PACKAGE_FFMPEG_DEMUXERS="h264"
BR2_PACKAGE_FFMPEG_PARSERS="mjpeg h264"
BR2_PACKAGE_FFMPEG_BSFS="h264_metadata opus_metadata"
BR2_PACKAGE_FFMPEG_PROTOCOLS="udp rtp pipe"
BR2_PACKAGE_FFMPEG_FILTERS="scale scale_vaapi aresample"
BR2_PACKAGE_FFMPEG_EXTRACONF=""

# Nginx
BR2_PACKAGE_NGINX=y
BR2_PACKAGE_NGINX_HTTP=y

# Janus
BR2_PACKAGE_JANUS_GATEWAY=y
BR2_PACKAGE_JANUS_GATEWAY_DEMOS=y
# BR2_PACKAGE_JANUS_GATEWAY_AUDIO_BRIDGE is not set
# BR2_PACKAGE_JANUS_GATEWAY_ECHO_TEST is not set
# BR2_PACKAGE_JANUS_GATEWAY_RECORDPLAY is not set
# BR2_PACKAGE_JANUS_GATEWAY_SIP_GATEWAY is not set
BR2_PACKAGE_JANUS_GATEWAY_STREAMING=y
# BR2_PACKAGE_JANUS_GATEWAY_TEXT_ROOM is not set
# BR2_PACKAGE_JANUS_GATEWAY_VIDEO_CALL is not set
# BR2_PACKAGE_JANUS_GATEWAY_VIDEO_ROOM is not set
# BR2_PACKAGE_JANUS_GATEWAY_VOICE_MAIL is not set
# BR2_PACKAGE_JANUS_GATEWAY_MQTT is not set
# BR2_PACKAGE_JANUS_GATEWAY_RABBITMQ is not set
BR2_PACKAGE_JANUS_GATEWAY_REST=y
# BR2_PACKAGE_JANUS_GATEWAY_UNIX_SOCKETS is not set
# BR2_PACKAGE_JANUS_GATEWAY_WEBSOCKETS is not set

# Python and some useful modules (like pyserial)
BR2_PACKAGE_PYTHON3=y
BR2_PACKAGE_PYTHON3_PYC_ONLY=y
BR2_PACKAGE_PYTHON_SERIAL=y
BR2_PACKAGE_PYTHON_REQUESTS=y
```

## rpi-image/package/nginx-rtmp-module/Config.in
```kconfig
config BR2_PACKAGE_NGINX_RTMP_MODULE
	bool "nginx-rtmp-module"
	depends on BR2_PACKAGE_NGINX_HTTP
	select BR2_PACKAGE_OPENSSL
    select BR2_PACKAGE_NGINX_HTTP_SSL_MODULE
	help
	  NGINX-based RTMP media streaming server.

	  https://github.com/arut/nginx-rtmp-module
```
